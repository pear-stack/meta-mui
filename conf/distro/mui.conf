## conf/distro/mui.conf
```bitbake
DISTRO_NAME = "mui"
DISTRO_VERSION = "0.1"

PACKAGE_CLASSES = "package_ipk"

DISTRO_FEATURES:append = "gles2 opengl eglfs rauc"
RUSTVERSION = "1.75.0"
RUST_VERSION = "1.75.0"

RPI_USE_U_BOOT = "1"
PREFERRED_PROVIDER_virtual/bootloader = "u-boot"
KERNEL_IMAGETYPE = "zImage"
KERNEL_BOOTCMD = "bootz"

WKS_FILE = "sdimage-dual-raspberrypi.wks.in"
```

## conf/layer.conf
```bitbake
# We have a conf and classes directory, add to BBPATH
BBPATH .= ":${LAYERDIR}"

# We have recipes-* directories, add to BBFILES
BBFILES += "${LAYERDIR}/recipes-*/*/*.bb \
            ${LAYERDIR}/recipes-*/*/*.bbappend"

BBFILE_COLLECTIONS += "meta-mui"
BBFILE_PATTERN_meta-mui = "^${LAYERDIR}/"
BBFILE_PRIORITY_meta-mui = "10"

LAYERDEPENDS_meta-mui = "core"
LAYERSERIES_COMPAT_meta-mui = "scarthgap"

EXTRA_IMAGE_FEATURES ?= "debug-tweaks ssh-server-openssh package-management"
LICENSE_FLAGS_ACCEPTED = "synaptics-killswitch"

PREFERRED_VERSION_slint-cpp = "1.9.0"
PREFERRED_VERSION_slint-cpp-native = "1.9.0"
```
